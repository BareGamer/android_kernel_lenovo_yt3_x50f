/* Copyright (c) 2014, The Linux Foundation. All rights reserved.
 *
 * This program is free software; you can redistribute it and/or modify
 * it under the terms of the GNU General Public License version 2 and
 * only version 2 as published by the Free Software Foundation.
 *
 * This program is distributed in the hope that it will be useful,
 * but WITHOUT ANY WARRANTY; without even the implied warranty of
 * MERCHANTABILITY or FITNESS FOR A PARTICULAR PURPOSE.  See the
 * GNU General Public License for more details.
 */

/*---------------------------------------------------------------------------
 * This file is autogenerated file using gcdb parser. Please do not edit it.
 * Update input XML file to add a new entry or update variable in this file
 * VERSION = "1.0"
 *---------------------------------------------------------------------------*/
&mdss_mdp {
	dsi_boent35523_800p_vid: qcom,mdss_dsi_boent35523_800p_video {
		qcom,mdss-dsi-panel-name = "boeNT35523 800p video mode dsi panel";
		qcom,mdss-dsi-panel-controller = <&mdss_dsi0>;
		qcom,mdss-dsi-panel-type = "dsi_video_mode";
		qcom,mdss-dsi-panel-destination = "display_1";
		qcom,mdss-dsi-panel-framerate = <60>;
		qcom,mdss-dsi-virtual-channel-id = <0>;
		qcom,mdss-dsi-stream = <0>;
		qcom,mdss-dsi-panel-width = <800>;
		qcom,mdss-dsi-panel-height = <1280>;
		qcom,mdss-dsi-h-front-porch = <50>;
		qcom,mdss-dsi-h-back-porch = <48>;
		qcom,mdss-dsi-h-pulse-width = <4>;
		qcom,mdss-dsi-h-sync-skew = <0>;
		qcom,mdss-dsi-v-back-porch = <16>;
		qcom,mdss-dsi-v-front-porch = <8>;
		qcom,mdss-dsi-v-pulse-width = <2>;
		qcom,mdss-dsi-h-left-border = <0>;
		qcom,mdss-dsi-h-right-border = <0>;
		qcom,mdss-dsi-v-top-border = <0>;
		qcom,mdss-dsi-v-bottom-border = <0>;
		qcom,mdss-dsi-bpp = <24>;
		qcom,mdss-dsi-underflow-color = <0xff>;
		qcom,mdss-dsi-border-color = <0>;
		qcom,mdss-dsi-on-command = [
			39 01 00 00 00 00 06 F0 55 AA 52 08 01
			39 01 00 00 00 00 02 CE 04
			39 01 00 00 00 00 03 BC 68 01
			39 01 00 00 00 00 03 BD 68 01
			39 01 00 00 00 00 05 FF AA 55 A5 80
			39 01 00 00 00 00 02 6F 09
			39 01 00 00 00 00 02 F7 82
			39 01 00 00 00 00 02 6F 0B
			39 01 00 00 00 00 02 F7 E0
			05 01 00 00 78 00 02 11 00
			05 01 00 00 0a 00 02 29 00
		];
		qcom,mdss-dsi-off-command = [
			05 01 00 00 14 00 02 28 00
			05 01 00 00 78 00 02 10 00];

		warm-command = [
			39 01 00 00 00 00 06 F0 55 AA 52 08 02
			39 01 00 00 00 00 02 B0 C0
			39 00 00 00 00 00 11 D1 00 01 00 12 00 32 00 4D 00 62 00 88 00 A7 00 DB
			39 00 00 00 00 00 11 D2 01 04 01 46 01 71 01 C8 02 0E 02 0F 02 4E 02 92
			39 00 00 00 00 00 11 D3 02 BD 02 F5 03 1C 03 48 03 6C 03 96 03 AF 03 C2
			39 01 00 00 00 00 05 D4 03 F8 03 FF
			39 00 00 00 00 00 11 D5 00 C6 00 CD 00 D7 00 E1 00 EB 00 FD 01 0F 01 30
			39 00 00 00 00 00 11 D6 01 4B 01 7C 01 A5 01 E9 02 24 02 26 02 5D 02 9E
			39 00 00 00 00 00 11 D7 02 C8 03 01 03 28 03 5B 03 7C 03 A3 03 BD 03 D8
			39 01 00 00 00 00 05 D8 03 F5 03 FF
			39 00 00 00 00 00 11 D9 01 3E 01 41 01 47 01 4D 01 52 01 5D 01 68 01 7E
			39 00 00 00 00 00 11 DD 01 90 01 B2 01 D2 02 0A 02 3D 02 3F 02 71 02 B1
			39 00 00 00 00 00 11 DE 02 DC 03 19 03 47 03 93 03 C0 03 CD 03 D2 03 E3
			39 01 00 00 00 00 05 DF 03 FB 03 FF
			                                ];
		default-command = [
			39 01 00 00 00 00 06 F0 55 AA 52 08 02
			39 01 00 00 00 00 02 B0 C0
			39 00 00 00 00 00 11 D1 00 01 00 12 00 32 00 4D 00 62 00 88 00 A7 00 DB
			39 00 00 00 00 00 11 D2 01 04 01 46 01 71 01 C8 02 0E 02 0F 02 4F 02 92
			39 00 00 00 00 00 11 D3 02 BE 02 F7 03 1F 03 51 03 71 03 96 03 AF 03 C2
			39 01 00 00 00 00 05 D4 03 F9 03 FF
			39 00 00 00 00 00 11 D5 00 01 00 12 00 31 00 4A 00 60 00 85 00 A4 00 D7
			39 00 00 00 00 00 11 D6 01 00 01 44 01 7A 01 CC 02 10 02 11 02 4F 02 91
			39 00 00 00 00 00 11 D7 02 BC 02 F6 03 1E 03 51 03 73 03 9E 03 B5 03 DD
			39 01 00 00 00 00 05 D8 03 F5 03 FF
			39 00 00 00 00 00 11 D9 00 15 00 24 00 3F 00 55 00 69 00 8D 00 AA 00 DB
			39 00 00 00 00 00 11 DD 01 03 01 45 01 78 01 CC 02 10 02 11 02 50 02 92
			39 00 00 00 00 00 11 DE 02 BE 02 FA 03 23 03 60 03 93 03 C8 03 CD 03 E3
			39 01 00 00 00 00 05 DF 03 FD 03 FF
			                                ];
		cold-command = [
			39 01 00 00 00 00 06 F0 55 AA 52 08 02
			39 01 00 00 00 00 02 B0 C0
			39 00 00 00 00 00 11 D1 00 BE 00 C4 00 D0 00 DC 00 E6 00 F9 01 0C 01 2A
			39 00 00 00 00 00 11 D2 01 47 01 72 01 9E 01 E8 02 25 02 27 02 5E 02 9F
			39 00 00 00 00 00 11 D3 02 C8 03 04 03 29 03 5B 03 71 03 96 03 AF 03 C2
			39 01 00 00 00 00 05 D4 03 F9 03 FF
			39 00 00 00 00 00 11 D5 00 F4 00 F9 01 01 01 09 01 11 01 20 01 2F 01 49
			39 00 00 00 00 00 11 D6 01 61 01 8E 01 B3 01 F2 02 2B 02 2D 02 62 02 A2
			39 00 00 00 00 00 11 D7 02 CD 03 06 03 2D 03 5F 03 73 03 9E 03 B5 03 D7
			39 01 00 00 00 00 05 D8 03 F5 03 FF
			39 00 00 00 00 00 11 D9 00 01 00 0F 00 29 00 40 00 53 00 75 00 95 00 C6
			39 00 00 00 00 00 11 DD 00 F1 01 34 01 6D 01 C5 02 0D 02 0F 02 4B 02 90
			39 00 00 00 00 00 11 DE 02 BA 02 F7 03 1E 03 55 03 8E 03 C8 03 CD 03 F4
			39 01 00 00 00 00 05 DF 03 FD 03 FF
			                                ];
		qcom,mdss-dsi-on-command-state = "dsi_lp_mode";
		qcom,mdss-dsi-off-command-state = "dsi_lp_mode";
		qcom,mdss-extra-command-state = "dsi_hs_mode";
		qcom,cont-splash-enabled;
		qcom,mdss-dsi-h-sync-pulse = <1>;
		qcom,mdss-dsi-traffic-mode = "burst_mode";
		qcom,mdss-dsi-bllp-eof-power-mode;
		qcom,mdss-dsi-bllp-power-mode;
		qcom,mdss-dsi-lane-0-state;
		qcom,mdss-dsi-lane-1-state;
		qcom,mdss-dsi-lane-2-state;
		qcom,mdss-dsi-lane-3-state;
		qcom,mdss-dsi-panel-timings = [7a 1a 12 00 3e 42 16 1e 14 03 04 00];
		qcom,mdss-dsi-t-clk-post = <0x04>;
		qcom,mdss-dsi-t-clk-pre = <0x1b>;
		qcom,mdss-dsi-bl-min-level = <1>;
		qcom,mdss-dsi-bl-max-level = <4095>;
		qcom,mdss-dsi-dma-trigger = "trigger_sw";
		qcom,mdss-dsi-mdp-trigger = "none";
		qcom,mdss-dsi-bl-pmic-control-type = "bl_ctrl_pwm";
		qcom,platform-bklight-en-gpio = <&msm_gpio 9 0>;//liyong2 2015.3.18
		qcom,mdss-dsi-lcden-ctrl = <&msm_gpio 24 0>;
		qcom,mdss-dsi-bl-pmic-pwm-frequency = <100>;
		qcom,mdss-dsi-bl-pmic-bank-select = <0>;
		qcom,mdss-dsi-pwm-gpio = <&pm8909_mpps 2 0>;
		qcom,mdss-dsi-reset-sequence = <1 20>, <0 10>, <1 120>;
		qcom,mdss-pan-physical-width-dimension = <108>;
		qcom,mdss-pan-physical-height-dimension = <172>;
	};
};
