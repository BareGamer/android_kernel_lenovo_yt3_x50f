/* Copyright (c) 2014, The Linux Foundation. All rights reserved.
 *
 * This program is free software; you can redistribute it and/or modify
 * it under the terms of the GNU General Public License version 2 and
 * only version 2 as published by the Free Software Foundation.
 *
 * This program is distributed in the hope that it will be useful,
 * but WITHOUT ANY WARRANTY; without even the implied warranty of
 * MERCHANTABILITY or FITNESS FOR A PARTICULAR PURPOSE.  See the
 * GNU General Public License for more details.
 */

/*---------------------------------------------------------------------------
 * This file is autogenerated file using gcdb parser. Please do not edit it.
 * Update input XML file to add a new entry or update variable in this file
 * VERSION = "1.0"
 *---------------------------------------------------------------------------*/
&mdss_mdp {
	dsi_samsang_800p_vid: qcom,mdss_dsi_dsbjs6d7aa0x04_800p_video {
		qcom,mdss-dsi-panel-name = "dongshan s6d7aa0x04 800p video mode dsi panel";
		qcom,mdss-dsi-panel-controller = <&mdss_dsi0>;
		qcom,mdss-dsi-panel-type = "dsi_video_mode";
		qcom,mdss-dsi-panel-destination = "display_1";
		qcom,mdss-dsi-panel-framerate = <60>;
		qcom,mdss-dsi-virtual-channel-id = <0>;
		qcom,mdss-dsi-stream = <0>;
		qcom,mdss-dsi-panel-width = <800>;
		qcom,mdss-dsi-panel-height = <1280>;
		qcom,mdss-dsi-h-front-porch = <24>;
		qcom,mdss-dsi-h-back-porch = <132>;
		qcom,mdss-dsi-h-pulse-width = <4>;
		qcom,mdss-dsi-h-sync-skew = <0>;
		qcom,mdss-dsi-v-back-porch = <8>;
		qcom,mdss-dsi-v-front-porch = <8>;
		qcom,mdss-dsi-v-pulse-width = <4>;
		qcom,mdss-dsi-h-left-border = <0>;
		qcom,mdss-dsi-h-right-border = <0>;
		qcom,mdss-dsi-v-top-border = <0>;
		qcom,mdss-dsi-v-bottom-border = <0>;
		qcom,mdss-dsi-bpp = <24>;
		qcom,mdss-dsi-underflow-color = <0xff>;
		qcom,mdss-dsi-border-color = <0>;
		qcom,mdss-dsi-on-command = [
			39 01 00 00 00 00 03 F0 5A 5A
			39 01 00 00 00 00 03 F1 5A 5A
			39 01 00 00 05 00 03 FC A5 5A
			39 01 00 00 00 00 03 D0 00 10
			39 01 00 00 0A 00 0B F3 01 C7 E2 62 F4 F7 77 3C 26 00
			39 01 00 00 32 00 04 C3 40 00 28
			23 01 00 00 00 00 02 F5 96
			05 01 00 00 C8 00 02 11 00
			05 01 00 00 78 00 02 29 00
		];
		qcom,mdss-dsi-off-command = [
			05 01 00 00 14 00 02 28 00
			39 01 00 00 32 00 04 C3 40 00 20
			05 01 00 00 78 00 02 10 00];
		warm-command = [
			23 01 00 00 00 00 02 B0 22
			39 01 00 00 00 00 12 FA 0A 32 11 15 1C 14 19 1D 1F 26 2C 33 3A 3C 35 31 34
			23 01 00 00 00 00 02 B0 22
			39 01 00 00 00 00 12 FB 0A 32 11 15 1C 14 19 1D 1F 26 2B 31 3A 3C 35 31 34
			23 01 00 00 00 00 02 B0 11
			39 01 00 00 00 00 12 FA 1D 32 1C 1C 1F 12 15 17 1A 23 2A 30 38 38 2B 29 2E
			23 01 00 00 00 00 02 B0 11
			39 00 00 00 00 00 12 FB 1D 32 1C 1C 1F 12 15 17 1A 23 29 30 38 38 2C 29 2E
			39 00 00 00 00 00 12 FA 37 32 3B 39 39 2B 2C 2A 24 28 2E 34 3D 3D 36 32 34
			39 01 00 00 00 00 12 FB 37 32 3B 39 39 2B 2C 2A 24 28 2C 33 3D 3D 36 32 34
			                                ];
		default-command = [
			23 01 00 00 00 00 02 B0 22
			39 01 00 00 00 00 12 FA 35 30 39 38 39 29 2A 29 24 28 2D 34 3E 3E 35 31 33
			23 01 00 00 00 00 02 B0 22
			39 01 00 00 00 00 12 FB 35 30 39 38 39 29 2A 29 24 28 2D 32 3E 3E 35 31 33
			23 01 00 00 00 00 02 B0 11
			39 01 00 00 00 00 12 FA 0F 30 15 17 1D 12 17 1B 1B 23 2A 31 38 38 30 2D 32
			23 01 00 00 00 00 02 B0 11
			39 00 00 00 00 00 12 FB 0F 30 15 17 1D 12 17 1B 1B 23 29 2F 38 38 30 2D 32
			39 00 00 00 00 00 12 FA 2E 30 2F 2F 2F 22 23 22 20 25 2C 33 39 39 31 2E 2C
			39 01 00 00 00 00 12 FB 2E 30 2F 2F 2F 22 23 22 20 25 2A 31 39 39 31 2E 2C
			                                ];
		cold-command = [
			23 01 00 00 00 00 02 B0 22
			39 01 00 00 00 00 12 FA 30 30 35 35 36 25 2B 2B 26 28 2D 30 3D 3D 35 31 33
			23 01 00 00 00 00 02 B0 22
			39 01 00 00 00 00 12 FB 30 30 35 35 36 25 2B 2B 26 28 2D 30 3D 3D 35 31 33
			23 01 00 00 00 00 02 B0 11
			39 01 00 00 00 00 12 FA 13 30 12 15 19 12 15 19 1A 23 29 31 38 38 30 2E 31
			23 01 00 00 00 00 02 B0 11
			39 00 00 00 00 00 12 FB 13 30 12 15 19 12 15 19 1A 22 29 31 38 38 30 2E 31
			39 00 00 00 00 00 12 FA 08 30 0E 11 17 10 16 1B 1A 22 29 2F 38 38 2F 2A 2E
			39 01 00 00 00 00 12 FB 08 30 0E 11 17 10 16 1B 1A 23 29 2F 38 38 2F 2A 2E
			                                ];
		qcom,mdss-dsi-on-command-state = "dsi_lp_mode";
		qcom,mdss-dsi-off-command-state = "dsi_lp_mode";
		qcom,mdss-extra-command-state = "dsi_lp_mode";
		qcom,cont-splash-enabled;
		qcom,mdss-dsi-h-sync-pulse = <1>;
		qcom,mdss-dsi-traffic-mode = "burst_mode";
		qcom,mdss-dsi-bllp-eof-power-mode;
		qcom,mdss-dsi-bllp-power-mode;
		qcom,mdss-dsi-lane-0-state;
		qcom,mdss-dsi-lane-1-state;
		qcom,mdss-dsi-lane-2-state;
		qcom,mdss-dsi-lane-3-state;
		qcom,mdss-dsi-panel-timings = [87 1c 12 00 40 44 16 1e 17 03 04 00];
		qcom,mdss-dsi-t-clk-post = <0x04>;
		qcom,mdss-dsi-t-clk-pre = <0x1b>;
		qcom,mdss-dsi-bl-min-level = <1>;
		qcom,mdss-dsi-bl-max-level = <4095>;
		qcom,mdss-dsi-dma-trigger = "trigger_sw";
		qcom,mdss-dsi-mdp-trigger = "none";
		qcom,mdss-dsi-bl-pmic-control-type = "bl_ctrl_pwm";
		qcom,platform-bklight-en-gpio = <&msm_gpio 9 0>;//liyong2 2015.3.18
		qcom,mdss-dsi-lcden-ctrl = <&msm_gpio 24 0>;
		qcom,mdss-dsi-bl-pmic-pwm-frequency = <100>;
		qcom,mdss-dsi-bl-pmic-bank-select = <0>;
		qcom,mdss-dsi-pwm-gpio = <&pm8909_mpps 2 0>;
		qcom,mdss-dsi-reset-sequence = <1 20>, <0 10>, <1 20>;
		qcom,mdss-pan-physical-width-dimension = <108>;
		qcom,mdss-pan-physical-height-dimension = <172>;
	};
};
